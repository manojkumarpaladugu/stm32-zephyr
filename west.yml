## west.yml
```yaml
manifest:
  defaults:
    remote: github

  remotes:
    - name: github
      url-base: ssh://git@github.com

  projects:
    - name: zephyr
      remote: github
      repo-path: manojkumarpaladugu/zephyr
      revision: v3.7.1
      path: zephyr
      import:
        # By using name-allowlist we can clone only the modules that are
        # strictly needed by the application.
        name-allowlist:
          - cmsis      # required by the ARM port
          - hal_stm32  # required by the nucleo_f302r8 board (STM32 based)
    - name: zephyr-plus
      remote: github
      repo-path: manojkumarpaladugu/zephyr-plus
      revision: main
      path: modules/zephyr-plus
    - name: Commons
      remote: github
      repo-path: manojkumarpaladugu/Commons
      revision: main
      path: modules/lib/Commons
    - name: vscode-debug-config
      remote: github
      repo-path: manojkumarpaladugu/vscode-debug-config
      revision: main
      path: .vscode
```
